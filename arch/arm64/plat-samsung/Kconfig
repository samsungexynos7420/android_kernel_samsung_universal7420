## arch/arm64/plat-samsung/Kconfig
```kconfig
# arch/arm/plat-samsung/Kconfig
#
# Copyright 2009 Simtec Electronics
#
# Licensed under GPLv2

config PLAT_SAMSUNG
	bool
	depends on PLAT_S3C24XX || ARCH_S3C64XX || PLAT_S5P
	default y
	select GENERIC_IRQ_CHIP
	select NO_IOPORT
	help
	  Base platform code for all Samsung SoC based systems

config PLAT_S5P
	bool
	depends on (ARCH_S5P64X0 || ARCH_S5PC100 || ARCH_S5PV210 || ARCH_EXYNOS)
	default y
	select ARCH_REQUIRE_GPIOLIB
	select ARM_GIC if ARCH_EXYNOS
	select ARM_VIC if !ARCH_EXYNOS
	select GIC_NON_BANKED if ARCH_EXYNOS4
	select NO_IOPORT
	select PLAT_SAMSUNG
	select S3C_GPIO_TRACK
	select S5P_GPIO_DRVSTR
	select SAMSUNG_CLKSRC if !COMMON_CLK
	select SAMSUNG_GPIOLIB_4BIT
	select SAMSUNG_IRQ_VIC_TIMER
	help
	  Base platform code for Samsung's S5P series SoC.

if PLAT_SAMSUNG

endif
```

## drivers/cpuidle/Kconfig.arm64
```kconfig
#
# ARM64 CPU Idle drivers
#

config ARM64_CPUIDLE
	bool "Generic ARM64 CPU idle Driver"
	select OF_IDLE_STATES
	help
	  Select this to enable generic cpuidle driver for ARM v8.
	  It provides a generic idle driver whose idle states are configured
	  at run-time through DT nodes. The CPUidle suspend backend is
	  initialized by the device tree parsing code on matching the entry
	  method to the respective CPU operations.

config ARM64_EXYNOS_CPUIDLE
	bool "Cpu Idle Driver for the ARM64 Exynos processors"
	depends on ARCH_EXYNOS
	select ARM64_CPU_SUSPEND
	select CPU_IDLE_MULTIPLE_DRIVERS
	select OF_IDLE_STATES
	help
	  Select this to enable cpuidle for ARM64 Exynos processors.
```

## drivers/media/platform/exynos/mfc/Kconfig
```kconfig
config VIDEO_EXYNOS_MFC
	bool "Exynos MFC Driver"
	default y
	depends on VIDEO_EXYNOS
	select VIDEOBUF2_CORE
	select EXYNOS_MFC_V9
	---help---
	  MFC driver for V4L2.

choice
depends on VIDEO_EXYNOS_MFC
prompt "MFC version"
default EXYNOS_MFC_V9
config EXYNOS_MFC_V8
prompt "MFC version 8"
	bool
	depends on ARCH_EXYNOS5 || ARCH_EXYNOS7
config EXYNOS_MFC_V9
prompt "MFC version 9"
	bool
	depends on ARCH_EXYNOS7
endchoice
```

## drivers/nfc/Kconfig
```kconfig
#
# Near Field Communication (NFC) devices
#

config SAMSUNG_NFC
    bool "Samsung NFC driver"
    default n
    help
      SAMSUNG NFC Driver.
      This driver provides support for SAMSUNG NFC products.
      You should select your NFC product and interface.

      Say Y here to compile support for SAMSUNG NFC driver into the
      kernel.

menu "Near Field Communication (NFC) devices"
	depends on SAMSUNG_NFC

config SEC_NFC
	bool "Samsung NFC driver"
	default n
	help
	  SAMSUNG NFC Driver.
	  This driver provides support for SAMSUNG NFC products.
	  You should select your NFC product and interface.

	  Say Y here to compile support for SAMSUNG NFC driver into the
	  kernel.

config SEC_NFC_I2C
	bool "SEC NFC driver"
	default n
	help
	  SAMSUNG NFC Driver.
	  This driver provides support for SAMSUNG NFC products.
	  You should select your NFC product and interface.

	  Say Y here to compile support for SAMSUNG NFC driver into the
	  kernel.

choice
	prompt "SEC NFC Products"
	depends on SEC_NFC
	default SEC_NFC_PRODUCT_N5
config SEC_NFC_PRODUCT_N5
	bool "N5"
endchoice

choice
	prompt "SEC NFC Interface"
	depends on SEC_NFC
	default SEC_NFC_IF_I2C
config SEC_NFC_IF_UART
	bool "UART"
config SEC_NFC_IF_I2C
	bool "I2C"
config SEC_NFC_IF_I2C_GPIO
	bool "I2C-GPIO (S/W-I2C)"
	select I2C_ALGOBIT
endchoice

config SEC_NFC_CLK_REQ
	bool "SEC NFC CLK REQ"
	default n
	help
	  SAMSUNG NFC CLR REQ feature.
	  This feature provides support for SAMSUNG NFC products.
	  You should select this feature if your NFC product uses AP CLK.

	  Say Y here to compile support for SAMSUNG NFC CLK REQ feature into the
	  kernel.

config ESE_P3_LSI
	bool "Oberthur ese driver"
	depends on SPI
	default n
	help
	  Oberthur Driver.
	  This driver provides support for LSI NXP combined ESE products.
	  You should select your NFC product and interface.

config ESE_GEM_LSI
	bool "Gemalto ese driver"
	depends on SPI
	default n
	help
	  Gemalto Driver.
	  This driver provides support for LSI NXP combined ESE products.
	  You should select your NFC product and interface.

config ESE_FACTORY_ONLY
	bool "Oberthur ese driver factory"
	depends on SPI
	default n
	help
	  Oberthur Driver.
	  This driver provides support for LSI NXP combined ESE products.
	  You should select your NFC product and interface.

config ESE_SECURE_ENABLE
	bool "ese pin protection enable"
	default n

config ESE_SECURE_GPIO
	string "gpio group for ese"

config ESE_SECURE_SPI_PORT
	int "ese spi port number"
	default	99

config NFC_PN547
	bool "NXP PN547 NFC Controller Driver"
	depends on I2C
	default n
	help
	  NXP PN547 Near Field Communication controller support.
	  This option enables device driver support for the NFC.
	  It is used by many services. NFC is fully controlled using I2C
	  to communication.

config NFC_PN547_CLK_BBCLK2
	bool "NXP PN547 NFC CLOCK Controller"
	depends on NFC_PN547
	default n
	help
	  NXP PN547 Near Field Communication controller support.
	  This option enables device driver support for the NFC.
	  It is used by many services. NFC is fully controlled using I2C
	  to communicate the AP chip.

config NFC_P61
	bool "NXP PN547 NFC Controller Driver"
	depends on SPI
	default n
	help
	  NXP PN547 Near Field Communication controller support.
	  This option enables device driver support for the NFC.
	  It is used by many services. NFC is fully controlled using I2C
	  to communication

config NFC_PN547_ESE_SUPPORT
	bool "NXP PN547 ESE SUPPORT"
	depends on NFC_PN547
	default n
	help
	  NXP PN547 Near Field Communication controller support.
	  This option enables device driver support for the NFC.
	  It is used by many services. NFC is fully controlled using I2C
	  to communication

config NFC_PN547_LDO_CONTROL
	bool "PN547 NFC LDO CONTROL"
	depends on NFC_PN547
	default n
	help
	  SAMSUNG PN547 NFC LDO CONTROL feature.
	  This feature provides support for NXP PN547 products.
	  You should select this feature if your NFC product uses ldo control of i2c.

	  Say Y here to compile support for NXP PN547 LDO CONTROL feature into the
	  kernel.

config SEC_NFC_LDO_CONTROL
	bool "SEC NFC LDO CONTROL"
	depends on SEC_NFC
	default n
	help
	  SAMSUNG SEC NFC LDO CONTROL feature.
	  This feature provides support for SAMSUNG NFC products.
	  You should select this feature if your NFC product uses ldo control of i2c.

	  Say Y here to compile support for SEC NFC LDO CONTROL feature into the
	  kernel.

source "drivers/nfc/secnfc/Kconfig"

endmenu
```

## drivers/soc/Kconfig
```kconfig
menu "SOC (System On Chip) specific Drivers"

source "drivers/soc/qcom/Kconfig"
source "drivers/soc/samsung/Kconfig"

endmenu
```

## drivers/soc/samsung/Kconfig
```kconfig
#
# EXYNOS Soc drivers
#
menuconfig SOC_SAMSUNG
	bool "SAMSUNG SOC drivers support"

if SOC_SAMSUNG
config EXYNOS_CHIPID
	bool "Exynos Chip ID Driver Support"
	depends on ARCH_EXYNOS

config EXYNOS5_SETUP_MIPIPHY
	bool
	depends on (VIDEO_EXYNOS_FIMC_IS || DECON_MIPI_DSI || EXYNOS_MIPI_DSI)
	default y
	help
		Compile in common setup code for MIPI-CSIS devices
	
config EXYNOS5_DYNAMIC_CPU_HOTPLUG
	bool "Dynamic CPU Hotplug support"
	depends on !SOC_EXYNOS7580
	depends on CPU_FREQ
	help
		Enable Dynamic CPU Hotplug

config EXYNOS5_DYNAMIC_CPU_HOTPLUG_SLEEP_PREPARE
        int "Activate number of cores when sleep"
        depends on EXYNOS5_DYNAMIC_CPU_HOTPLUG
        default 1
        help
		When gose to sleep, activate some cores for performace
		during sleep/wakeup sequence.
		This config set the number of activate cores.
		defaut value is "4" to activate all cores in cluster0.

config EXYNOS_HOTPLUG_GOVERNOR
	bool "Enable Exynos dynamic hotplug governor"

config SCHED_HP_EVENT
	bool "Gathers scheduler events to decide hotplug in/out"
	depends on EXYNOS_HOTPLUG_GOVERNOR
	default y

config HP_EVENT_THREAD_GROUP
	bool "Gathres thread group information"
	depends on SCHED_HP_EVENT && SCHED_HMP
	default n

config HP_EVENT_HMP_SYSTEM_LOAD
	bool "Gathres system load information"
	depends on SCHED_HP_EVENT && SCHED_HMP
	default y
endif #SOC_SAMSUNG
```
